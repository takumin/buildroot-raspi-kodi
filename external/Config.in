## external/Config.in
```kconfig
source "$BR2_EXTERNAL_RASPI_PATH/package/rpi-firmware-external/Config.in"
source "$BR2_EXTERNAL_RASPI_PATH/package/libarib25/Config.in"
source "$BR2_EXTERNAL_RASPI_PATH/package/recdvb/Config.in"
source "$BR2_EXTERNAL_RASPI_PATH/package/recpt1/Config.in"
source "$BR2_EXTERNAL_RASPI_PATH/package/mirakc-arib/Config.in"
source "$BR2_EXTERNAL_RASPI_PATH/package/mirakc/Config.in"
source "$BR2_EXTERNAL_RASPI_PATH/package/accountsservice/Config.in"
source "$BR2_EXTERNAL_RASPI_PATH/package/gdm/Config.in"
source "$BR2_EXTERNAL_RASPI_PATH/package/libcanberra/Config.in"
```

## external/configs/raspberrypi4_64_kodi_defconfig
```kconfig
# Mirrors
BR2_DL_DIR="$(DL_DIR)"
BR2_KERNEL_MIRROR="https://ftp.jaist.ac.jp/pub/Linux/kernel.org"
BR2_GNU_MIRROR="https://ftp.jaist.ac.jp/pub/GNU"
BR2_CPAN_MIRROR="https://ftp.jaist.ac.jp/pub/CPAN"

# Toolchain
BR2_TOOLCHAIN=y
BR2_TOOLCHAIN_EXTERNAL=y
BR2_TOOLCHAIN_EXTERNAL_DOWNLOAD=y
BR2_TOOLCHAIN_EXTERNAL_ARM_AARCH64=y

# Ccache
BR2_CCACHE=y
BR2_CCACHE_DIR="$(CCACHE_DIR)"
BR2_CCACHE_INITIAL_SETUP="--max-size 8G"

# Disable build-id
BR2_REPRODUCIBLE=y

# Architecture
BR2_aarch64=y
BR2_cortex_a72=y
BR2_ARM_FPU_VFPV4=y

# System
BR2_INIT_SYSTEMD=y
BR2_SYSTEM_DHCP="end0"
BR2_SYSTEM_DEFAULT_PATH="/usr/sbin:/usr/bin:/sbin:/bin"
BR2_TARGET_ENABLE_ROOT_LOGIN=y
BR2_TARGET_GENERIC_ROOT_PASSWD="root"
BR2_TARGET_GENERIC_PASSWD_SHA512=y
BR2_TARGET_GENERIC_GETTY_PORT="ttyAMA0"
BR2_TARGET_TZ_INFO=y
BR2_TARGET_TZ_ZONELIST="default"
BR2_TARGET_LOCALTIME="Asia/Tokyo"

# Linux headers same as kernel, a 6.1 series
BR2_PACKAGE_HOST_LINUX_HEADERS_CUSTOM_6_1=y

# Kernel
BR2_LINUX_KERNEL=y
BR2_LINUX_KERNEL_CUSTOM_TARBALL=y
BR2_LINUX_KERNEL_CUSTOM_TARBALL_LOCATION="$(call github,raspberrypi,linux,a1caea3c996f6bfa8c9568f521257f4e473285fb)/linux-a1caea3c996f6bfa8c9568f521257f4e473285fb.tar.gz"
BR2_LINUX_KERNEL_DEFCONFIG="bcm2711"

# Build the DTB from the kernel sources
BR2_LINUX_KERNEL_DTS_SUPPORT=y
BR2_LINUX_KERNEL_DTB_OVERLAY_SUPPORT=y
BR2_LINUX_KERNEL_INTREE_DTS_NAME="broadcom/bcm2711-rpi-4-b"

# Kernel Compression
BR2_LINUX_KERNEL_XZ=y

# Host OpenSSL Package
BR2_LINUX_KERNEL_NEEDS_HOST_OPENSSL=y

# Host Handle Kernel Modules
BR2_PACKAGE_HOST_KMOD=y
BR2_PACKAGE_HOST_KMOD_XZ=y

# Handle Kernel Modules
BR2_PACKAGE_KMOD=y
BR2_PACKAGE_KMOD_TOOLS=y
BR2_PACKAGE_XZ=y

# Merge /usr directory
BR2_ROOTFS_MERGED_USR=y

# Rootfs
BR2_ROOTFS_USERS_TABLES="$(BR2_EXTERNAL_RASPI_PATH)/board/users-tables.txt"
BR2_ROOTFS_POST_BUILD_SCRIPT="$(BR2_EXTERNAL_RASPI_PATH)/board/post-build.sh"
BR2_ROOTFS_POST_FAKEROOT_SCRIPT="$(BR2_EXTERNAL_RASPI_PATH)/board/post-fakeroot.sh"
BR2_ROOTFS_POST_IMAGE_SCRIPT="$(BR2_EXTERNAL_RASPI_PATH)/board/post-image.sh"

# Initramfs
BR2_TARGET_ROOTFS_CPIO=y
BR2_TARGET_ROOTFS_CPIO_XZ=y

# Disable tarball rootfs
BR2_TARGET_ROOTFS_TAR=n

# Raspberry Pi Firmware
BR2_PACKAGE_RPI_FIRMWARE_EXTERNAL=y
BR2_PACKAGE_RPI_FIRMWARE_EXTERNAL_BOOTCODE_BIN=y
BR2_PACKAGE_RPI_FIRMWARE_EXTERNAL_VARIANT_PI=y
BR2_PACKAGE_RPI_FIRMWARE_EXTERNAL_VARIANT_PI_X=y
BR2_PACKAGE_RPI_FIRMWARE_EXTERNAL_VARIANT_PI_CD=y
BR2_PACKAGE_RPI_FIRMWARE_EXTERNAL_VARIANT_PI_DB=y
BR2_PACKAGE_RPI_FIRMWARE_EXTERNAL_VARIANT_PI4=y
BR2_PACKAGE_RPI_FIRMWARE_EXTERNAL_VARIANT_PI4_X=y
BR2_PACKAGE_RPI_FIRMWARE_EXTERNAL_VARIANT_PI4_CD=y
BR2_PACKAGE_RPI_FIRMWARE_EXTERNAL_VARIANT_PI4_DB=y
BR2_PACKAGE_RPI_FIRMWARE_EXTERNAL_CONFIG_FILE="$(BR2_EXTERNAL_RASPI_PATH)/board/config.txt"
BR2_PACKAGE_RPI_FIRMWARE_EXTERNAL_CMDLINE_FILE="$(BR2_EXTERNAL_RASPI_PATH)/board/cmdline.txt"

# Raspberry Pi Firmware (Bluetooth/Wifi)
BR2_PACKAGE_BRCMFMAC_SDIO_FIRMWARE_RPI=y
BR2_PACKAGE_BRCMFMAC_SDIO_FIRMWARE_RPI_BT=y
BR2_PACKAGE_BRCMFMAC_SDIO_FIRMWARE_RPI_WIFI=y

# Wireless regulatory database
BR2_PACKAGE_WIRELESS_REGDB=y

# Wireless tools and daemon
BR2_PACKAGE_IW=y
BR2_PACKAGE_IWD=y

# Raspberry Pi Userland Tools
BR2_PACKAGE_RPI_USERLAND=y

# Daemon to balance interrupts for SMP systems
BR2_PACKAGE_IRQBALANCE=y

# Systemd
BR2_PACKAGE_SYSTEMD_LOGIND=y
BR2_PACKAGE_SYSTEMD_UTMP=y

# UPower
BR2_PACKAGE_UPOWER=y

# PAM
BR2_PACKAGE_LINUX_PAM=y

# NSS
BR2_PACKAGE_LIBNSS=y

# Secure Shell Server and Client
BR2_PACKAGE_OPENSSH=y

# Cryptography SSL/TLS Toolkit
BR2_PACKAGE_OPENSSL=y
BR2_PACKAGE_LIBOPENSSL=y
BR2_PACKAGE_LIBOPENSSL_BIN=y

# Certificate Authority Certificates
BR2_PACKAGE_CA_CERTIFICATES=y

# Asynchronous Resolver
BR2_PACKAGE_C_ARES=y

# XML/XSLT
BR2_PACKAGE_LIBXML2=y
BR2_PACKAGE_LIBXSLT=y

# Secure Shell Library
BR2_PACKAGE_LIBSSH2=y

# I18N Domain
BR2_PACKAGE_LIBIDN2=y

# Brotli
BR2_PACKAGE_BROTLI=y

# HTTP2
BR2_PACKAGE_NGHTTP2=y

# cURL
BR2_PACKAGE_LIBCURL=y
BR2_PACKAGE_LIBCURL_CURL=y

# Bluetooth Utility
BR2_PACKAGE_BLUEZ5_UTILS=y
BR2_PACKAGE_BLUEZ5_UTILS_CLIENT=y

# Avahi mDNS Daemon
BR2_PACKAGE_AVAHI=y
BR2_PACKAGE_AVAHI_AUTOIPD=y
BR2_PACKAGE_AVAHI_DAEMON=y
BR2_PACKAGE_AVAHI_LIBAVAHI_CLIENT=y
BR2_PACKAGE_AVAHI_LIBDNSSD_COMPATIBILITY=y

# PipeWire
BR2_PACKAGE_PIPEWIRE=y
BR2_PACKAGE_PIPEWIRE_V4L2=y

# PulseAudio
BR2_PACKAGE_PULSEAUDIO=y

# Mesa
BR2_PACKAGE_MESA3D=y
BR2_PACKAGE_MESA3D_DRIVER=y
BR2_PACKAGE_MESA3D_GALLIUM_DRIVER=y
BR2_PACKAGE_MESA3D_GALLIUM_DRIVER_V3D=y
BR2_PACKAGE_MESA3D_OPENGL_GLX=y
BR2_PACKAGE_MESA3D_OPENGL_ES=y

# Xorg
BR2_PACKAGE_XORG7=y

# Xorg Servers
# BR2_PACKAGE_XSERVER_XORG_SERVER=y
BR2_PACKAGE_XWAYLAND=y

# Xorg Input (Required xorg-server)
BR2_PACKAGE_XDRIVER_XF86_INPUT_EVDEV=y
BR2_PACKAGE_XDRIVER_XF86_INPUT_LIBINPUT=y
BR2_PACKAGE_XDRIVER_XF86_INPUT_MOUSE=y

# Xorg Video (Required xorg-server)
BR2_PACKAGE_XDRIVER_XF86_VIDEO_FBDEV=y

# GTK3
BR2_PACKAGE_LIBGTK3=y

# Graphical Boot
BR2_PACKAGE_SYSTEMD_DEFAULT_TARGET="graphical.target"

# Display Manager
BR2_PACKAGE_GDM=y

# Window Manager
BR2_PACKAGE_MATCHBOX=y
BR2_PACKAGE_MATCHBOX_SM=y

# Python
# BR2_PACKAGE_PYTHON3=y
# BR2_PACKAGE_PYTHON3_PY_PYC=y

# Kodi
# BR2_PACKAGE_KODI=y
# BR2_PACKAGE_KODI_ALSA_LIB=y
# BR2_PACKAGE_KODI_AVAHI=y
# BR2_PACKAGE_KODI_BLUEZ=y
# BR2_PACKAGE_KODI_DBUS=y
# BR2_PACKAGE_KODI_EVENTCLIENTS=y
# BR2_PACKAGE_KODI_LIBCEC=y
# BR2_PACKAGE_KODI_LIBMICROHTTPD=y
# BR2_PACKAGE_KODI_PULSEAUDIO=y
# BR2_PACKAGE_KODI_RENDER_SYSTEM_GLES=y
# BR2_PACKAGE_KODI_UPNP=y
```

## external/configs/raspberrypi4_64_minimal_defconfig
```kconfig
# Mirrors
BR2_DL_DIR="$(DL_DIR)"
BR2_KERNEL_MIRROR="https://ftp.jaist.ac.jp/pub/Linux/kernel.org"
BR2_GNU_MIRROR="https://ftp.jaist.ac.jp/pub/GNU"
BR2_CPAN_MIRROR="https://ftp.jaist.ac.jp/pub/CPAN"

# Toolchain
BR2_TOOLCHAIN=y
BR2_TOOLCHAIN_EXTERNAL=y
BR2_TOOLCHAIN_EXTERNAL_DOWNLOAD=y
BR2_TOOLCHAIN_EXTERNAL_ARM_AARCH64=y

# Ccache
BR2_CCACHE=y
BR2_CCACHE_DIR="$(CCACHE_DIR)"
BR2_CCACHE_INITIAL_SETUP="--max-size 8G"

# Disable build-id
BR2_REPRODUCIBLE=y

# Architecture
BR2_aarch64=y
BR2_cortex_a72=y
BR2_ARM_FPU_VFPV4=y

# System
BR2_INIT_SYSTEMD=y

# Disable tarball rootfs
BR2_TARGET_ROOTFS_TAR=n
```

## external/package/accountsservice/Config.in
```kconfig
comment "accountsservice needs python3 and a glibc toolchain w/ wchar, threads, gcc >= 4.9, host gcc >= 8"
	depends on BR2_USE_MMU
	depends on BR2_PACKAGE_GOBJECT_INTROSPECTION_ARCH_SUPPORTS
	depends on !BR2_HOST_GCC_AT_LEAST_8 || !BR2_PACKAGE_PYTHON3 || \
		!BR2_TOOLCHAIN_GCC_AT_LEAST_4_9 || !BR2_TOOLCHAIN_HAS_THREADS || \
		!BR2_TOOLCHAIN_USES_GLIBC || !BR2_USE_WCHAR

config BR2_PACKAGE_ACCOUNTSSERVICE
	bool "accountsservice"
	depends on BR2_HOST_GCC_AT_LEAST_8 # gobject-introspection
	depends on BR2_PACKAGE_GOBJECT_INTROSPECTION_ARCH_SUPPORTS # gobject-introspection
	depends on BR2_TOOLCHAIN_GCC_AT_LEAST_4_9 # gobject-introspection
	depends on BR2_TOOLCHAIN_HAS_THREADS # libglib2
	depends on BR2_TOOLCHAIN_USES_GLIBC # gobject-introspection
	depends on BR2_USE_MMU # libglib2
	depends on BR2_USE_WCHAR # libglib2
	select BR2_PACKAGE_DBUS
	select BR2_PACKAGE_GOBJECT_INTROSPECTION
	select BR2_PACKAGE_LIBGLIB2
	select BR2_PACKAGE_POLKIT
	select BR2_PACKAGE_PYTHON3
	select BR2_PACKAGE_SYSTEMD_UTMP
	help
	  query and manipulate user account information.

	  https://www.freedesktop.org/wiki/Software/AccountsService/
```

## external/package/gdm/Config.in
```kconfig
comment "gdm needs a glibc toolchain w/ dynamic library, wchar, ssp, threads, libstd++, gcc >= 5, host gcc >= 8"
	depends on BR2_USE_MMU # systemd
	depends on BR2_PACKAGE_SYSTEMD_ARCH_SUPPORTS # systemd
	depends on BR2_PACKAGE_HOST_RUSTC_ARCH_SUPPORTS # libgtk3
	depends on BR2_PACKAGE_GOBJECT_INTROSPECTION_ARCH_SUPPORTS # accountsservice
	depends on \
		BR2_STATIC_LIBS || \
		!BR2_USE_WCHAR || \
		!BR2_INSTALL_LIBSTDCPP || \
		!BR2_TOOLCHAIN_GCC_AT_LEAST_5 || \
		!BR2_TOOLCHAIN_HAS_SSP || \
		!BR2_TOOLCHAIN_HAS_SYNC_4 || \
		!BR2_TOOLCHAIN_HAS_THREADS || \
		!BR2_TOOLCHAIN_HEADERS_AT_LEAST_4_14 || \
		!BR2_TOOLCHAIN_USES_GLIBC || \
		!BR2_HOST_GCC_AT_LEAST_8

comment "gdm needs systemd"
	depends on BR2_USE_MMU # systemd
	depends on BR2_PACKAGE_SYSTEMD_ARCH_SUPPORTS # systemd
	depends on BR2_PACKAGE_HOST_RUSTC_ARCH_SUPPORTS # libgtk3
	depends on BR2_PACKAGE_GOBJECT_INTROSPECTION_ARCH_SUPPORTS # accountsservice
	depends on !BR2_PACKAGE_SYSTEMD

comment "gdm needs libgtk3"
	depends on BR2_USE_MMU # systemd
	depends on BR2_PACKAGE_SYSTEMD_ARCH_SUPPORTS # systemd
	depends on BR2_PACKAGE_HOST_RUSTC_ARCH_SUPPORTS # libgtk3
	depends on BR2_PACKAGE_GOBJECT_INTROSPECTION_ARCH_SUPPORTS # accountsservice
	depends on !BR2_PACKAGE_LIBGTK3

comment "gdm needs xorg-server or xwayland-server"
	depends on BR2_USE_MMU # systemd
	depends on BR2_PACKAGE_SYSTEMD_ARCH_SUPPORTS # systemd
	depends on BR2_PACKAGE_HOST_RUSTC_ARCH_SUPPORTS # libgtk3
	depends on BR2_PACKAGE_GOBJECT_INTROSPECTION_ARCH_SUPPORTS # accountsservice
	depends on !BR2_PACKAGE_XSERVER_XORG_SERVER && !BR2_PACKAGE_XWAYLAND

config BR2_PACKAGE_GDM
	bool "gdm"
	depends on BR2_USE_MMU # systemd
	depends on BR2_PACKAGE_SYSTEMD_ARCH_SUPPORTS # systemd
	depends on BR2_PACKAGE_HOST_RUSTC_ARCH_SUPPORTS # libgtk3
	depends on BR2_PACKAGE_GOBJECT_INTROSPECTION_ARCH_SUPPORTS # accountsservice
	depends on !BR2_STATIC_LIBS # libcanberra
	depends on BR2_USE_WCHAR # libglib2
	depends on BR2_INSTALL_LIBSTDCPP # libgtk3
	depends on BR2_TOOLCHAIN_GCC_AT_LEAST_5 # systemd
	depends on BR2_TOOLCHAIN_HAS_SSP # systemd
	depends on BR2_TOOLCHAIN_HAS_SYNC_4 # libgtk3
	depends on BR2_TOOLCHAIN_HAS_THREADS # libglib2
	depends on BR2_TOOLCHAIN_HEADERS_AT_LEAST_4_14 # systemd
	depends on BR2_TOOLCHAIN_USES_GLIBC # systemd
	depends on BR2_HOST_GCC_AT_LEAST_8 # accountsservice
	depends on BR2_PACKAGE_SYSTEMD
	depends on BR2_PACKAGE_LIBGTK3
	depends on BR2_PACKAGE_XSERVER_XORG_SERVER || BR2_PACKAGE_XWAYLAND
	select BR2_PACKAGE_ACCOUNTSSERVICE
	select BR2_PACKAGE_LIBCANBERRA
	select BR2_PACKAGE_LIBGLIB2
	select BR2_PACKAGE_LIBGTK3_WAYLAND if BR2_PACKAGE_XWAYLAND
	select BR2_PACKAGE_LIBGTK3_X11 if BR2_PACKAGE_XSERVER_XORG_SERVER
	select BR2_PACKAGE_LIBGUDEV
	select BR2_PACKAGE_LIBXCB
	select BR2_PACKAGE_LINUX_PAM
	select BR2_PACKAGE_SYSTEMD_LOGIND
	select BR2_PACKAGE_SYSTEMD_UTMP
	select BR2_PACKAGE_XLIB_LIBX11
	select BR2_PACKAGE_XLIB_LIBXAU
	help
	  The GNOME Display Manager (GDM) is a program that manages
	  graphical display servers and handles graphical user logins.

	  https://wiki.gnome.org/Projects/GDM

if BR2_PACKAGE_GDM

config BR2_PACKAGE_GDM_INITIAL_VT
	int "Initial virtual terminal to use."
	default 1

config BR2_PACKAGE_GDM_IPV6
	bool "Enables compilation of IPv6 code."

config BR2_PACKAGE_GDM_XSESSION
	bool "Enable installing the gdm Xsession file."
	default y

config BR2_PACKAGE_GDM_KEYUTILS
	bool "Enable support keyutils."
	select BR2_PACKAGE_KEYUTILS

config BR2_PACKAGE_GDM_SELINUX
	bool "Enable support selinux."
	select BR2_PACKAGE_LIBSELINUX

config BR2_PACKAGE_GDM_XDMCP
	bool "Enable support xdmcp."
	select BR2_PACKAGE_XLIB_LIBXDMCP

config BR2_PACKAGE_GDM_AUDIT
	bool "Enable support audit."
	depends on BR2_PACKAGE_AUDIT_ARCH_SUPPORTS
	select BR2_PACKAGE_AUDIT

endif
```

## external/package/gnome-session/Config.in
```kconfig
config BR2_PACKAGE_GNOME_SESSION
	bool "gnome-session"
	help
	  Session management in GNOME is handled by gnome-session.

	  https://wiki.gnome.org/Projects/SessionManagement
```

## external/package/libarib25/Config.in
```kconfig
config BR2_PACKAGE_LIBARIB25
	bool "libarib25"
	depends on BR2_INSTALL_LIBSTDCPP # needs C++ compiler
	depends on BR2_USE_WCHAR # needs C99 compiler
	select BR2_PACKAGE_PCSC_LITE
	help
	  Basic implementation of the ARIB STD-B25 public standard.

	  https://github.com/stz2012/libarib25

comment "libarib25 needs a toolchain w/ C++, wchar"
	depends on !BR2_INSTALL_LIBSTDCPP || !BR2_USE_WCHAR
```

## external/package/libcanberra/Config.in
```kconfig
comment "libcanberra needs a toolchain w/ wchar, threads, dynamic library"
	depends on !BR2_USE_WCHAR || !BR2_TOOLCHAIN_HAS_THREADS || BR2_STATIC_LIBS

comment "libcanberra needs a alsa-lib or pulseaudio or gstreamer"
	depends on !BR2_PACKAGE_ALSA_LIB && !BR2_PACKAGE_PULSEAUDIO && !BR2_PACKAGE_GSTREAMER1

config BR2_PACKAGE_LIBCANBERRA
	bool "libcanberra"
	depends on BR2_USE_WCHAR
	depends on BR2_TOOLCHAIN_HAS_THREADS
	depends on !BR2_STATIC_LIBS
	select BR2_PACKAGE_LIBTOOL
	select BR2_PACKAGE_LIBVORBIS
	help
	  libcanberra defines a simple abstract interface for playing event sounds.

	  http://0pointer.de/lennart/projects/libcanberra/
```

## external/package/mirakc-arib/Config.in
```kconfig
config BR2_PACKAGE_MIRAKC_ARIB
	bool "mirakc-arib"
	depends on BR2_INSTALL_LIBSTDCPP # needs C++ compiler
	depends on BR2_TOOLCHAIN_HAS_THREADS # needs pthread
	depends on BR2_USE_WCHAR # needs C99 compiler
	help
	  Mirakurun compatible PVR backend Mirakc tools.

	  https://github.com/mirakc/mirakc-arib

comment "mirakc-arib needs a toolchain w/ C++, threads, wchar"
	depends on !BR2_INSTALL_LIBSTDCPP || !BR2_TOOLCHAIN_HAS_THREADS || !BR2_USE_WCHAR
```

## external/package/mirakc/Config.in
```kconfig
config BR2_PACKAGE_MIRAKC
	bool "mirakc"
	depends on BR2_PACKAGE_HOST_RUSTC_TARGET_ARCH_SUPPORTS
	select BR2_PACKAGE_HOST_RUSTC
	select BR2_PACKAGE_LIBFUSE3
	help
	  Mirakurun-compatible PVR backend written in Rust.

	  https://github.com/mirakc/mirakc
```

## external/package/recdvb/Config.in
```kconfig
config BR2_PACKAGE_RECDVB
	bool "recdvb"
	depends on BR2_TOOLCHAIN_HAS_THREADS # needs pthread
	depends on BR2_USE_WCHAR # needs C99 compiler
	help
	  PLEX PX-S1UD/PX-BCUD Recoding Application.

	  http://cgi1.plala.or.jp/~sat/?x=entry:entry160313-022002

comment "recdvb needs a toolchain w/ threads, wchar"
	depends on !BR2_TOOLCHAIN_HAS_THREADS || !BR2_USE_WCHAR
```

## external/package/recpt1/Config.in
```kconfig
config BR2_PACKAGE_RECPT1
	bool "recpt1"
	depends on BR2_TOOLCHAIN_HAS_THREADS # needs pthread
	depends on BR2_USE_WCHAR # needs C99 compiler
	help
	  Earthsoft PT1/PT2/PT3 Recoding Application.

	  https://github.com/stz2012/recpt1

comment "recpt1 needs a toolchain w/ threads, wchar"
	depends on !BR2_TOOLCHAIN_HAS_THREADS || !BR2_USE_WCHAR
```
