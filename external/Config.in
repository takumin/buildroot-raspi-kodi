## external/package/rpi-firmware-external/Config.in
```kconfig
config BR2_PACKAGE_RPI_FIRMWARE_EXTERNAL
	bool "rpi-firmware-external"
	depends on BR2_arm || BR2_aarch64
	help
	  RaspberryPi Firmware

	  Pre-compiled binaries of the current bootloader and GPU
	  firmware

	  https://github.com/raspberrypi/firmware

if BR2_PACKAGE_RPI_FIRMWARE_EXTERNAL

config BR2_PACKAGE_RPI_FIRMWARE_EXTERNAL_BOOTCODE_BIN
	bool "rpi 0/1/2/3 bootcode.bin"
	help
	  The bootcode.bin for versions Zero/1/2/3 (not needed on rpi4,
	  because it has been replaced by boot code in the onboard
	  EEPROM).

config BR2_PACKAGE_RPI_FIRMWARE_EXTERNAL_VARIANT_PI
	bool "rpi 0/1/2/3 (default)"
	help
	  The default set of files for versions Zero/1/2/3.

config BR2_PACKAGE_RPI_FIRMWARE_EXTERNAL_VARIANT_PI_X
	bool "rpi 0/1/2/3 (extended)"
	help
	  The extended set of files for versions Zero/1/2/3 (additional
	  GPU features, eg. more audio/video codecs).

config BR2_PACKAGE_RPI_FIRMWARE_EXTERNAL_VARIANT_PI_CD
	bool "rpi 0/1/2/3 (cut-down)"
	help
	  The cut-down set of files for versions Zero/1/2/3 (only
	  features required to boot a Linux kernel).

config BR2_PACKAGE_RPI_FIRMWARE_EXTERNAL_VARIANT_PI_DB
	bool "rpi 0/1/2/3 (debug)"
	help
	  The debug set of files for versions Zero/1/2/3.

config BR2_PACKAGE_RPI_FIRMWARE_EXTERNAL_VARIANT_PI4
	bool "rpi 4 (default)"
	help
	  The default set of files for versions 4 (standard GPU
	  features).

config BR2_PACKAGE_RPI_FIRMWARE_EXTERNAL_VARIANT_PI4_X
	bool "rpi 4 (extended)"
	help
	  The extended set of files for versions 4 (additional GPU
	  features, eg. more audio/video codecs).

config BR2_PACKAGE_RPI_FIRMWARE_EXTERNAL_VARIANT_PI4_CD
	bool "rpi 4 (cut-down)"
	help
	  The cut-down set of files for versions 4 (only features
	  required to boot a Linux kernel).

config BR2_PACKAGE_RPI_FIRMWARE_EXTERNAL_VARIANT_PI4_DB
	bool "rpi 4 (debug)"
	help
	  The debug set of files for versions 4.

config BR2_PACKAGE_RPI_FIRMWARE_EXTERNAL_CONFIG_FILE
	string "Path to a file stored as boot/config.txt"
	help
	  Path to a file stored as config.txt in the boot partiton
	  of the generated SD card image.

config BR2_PACKAGE_RPI_FIRMWARE_EXTERNAL_CMDLINE_FILE
	string "Path to a file stored as boot/cmdline.txt"
	help
	  Path to a file stored as cmdline.txt in the boot partiton
	  of the generated SD card image.

endif # BR2_PACKAGE_RPI_FIRMWARE_EXTERNAL
```
